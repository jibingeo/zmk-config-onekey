## config/boards/shields/onekey/Kconfig.defconfig
```kconfig
# Copyright (c) 2020 The ZMK Contributors
# SPDX-License-Identifier: MIT

config ZMK_USB
	default y

if SHIELD_ONEKEY

config ZMK_KEYBOARD_NAME
	default "The One Key"

endif
```

## config/boards/shields/onekey/Kconfig.shield
```kconfig
# Copyright (c) 2020 The ZMK Contributors
# SPDX-License-Identifier: MIT

config SHIELD_ONEKEY
	def_bool $(shields_list_contains,onekey)
```
